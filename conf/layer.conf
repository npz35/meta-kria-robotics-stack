## conf/layer.conf
```bitbake
# We have a conf and classes directory, add to BBPATH
BBPATH .= ":${LAYERDIR}"

# We have recipes-* directories, add to BBFILES
BBFILES += "${LAYERDIR}/recipes-*/*/*.bb \
            ${LAYERDIR}/recipes-*/*/*.bbappend"

BBFILE_COLLECTIONS += "meta-kria-robotics-stack"
BBFILE_PATTERN_meta-kria-robotics-stack = "^${LAYERDIR}/"
BBFILE_PRIORITY_meta-kria-robotics-stack = "6"

LAYERDEPENDS_meta-kria-robotics-stack = "core"
LAYERSERIES_COMPAT_meta-kria-robotics-stack = "langdale"
```
